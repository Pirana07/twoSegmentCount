
// პინების მნიშვნელობები
int pinA = 2;  // პინი A
int pinB = 3;  // პინი B
int pinC = 4;  // პინი C
int pinD = 5;  // პინი D
int pinE = 6;  // პინი E
int pinF = 8;  // პინი F
int pinG = 7;  // პინი G
int D1 = 9;   // პირველი სეგმენტური დისპლეის საერთო პინი
int D2 = 10;  // მეორე სეგმენტური დისპლეის საერთო პინი

int i = 0;  // ერთეულების ციფრი
int k = 0;  // ათეულების ციფრი

// სეგმენტების პინების დავაჭირებელი მორგება
int Arduino_Pins[7] = {pinA, pinB, pinC, pinD, pinE, pinF, pinG};
int Segment_Pins[10][7] = {
  {1, 1, 1, 1, 1, 1, 0}, // 0
  {0, 1, 1, 0, 0, 0, 0}, // 1
  {1, 1, 0, 1, 1, 0, 1}, // 2
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  {1, 1, 1, 1, 0, 1, 1}  // 9
};

void setup() {
  // ყველა სედმენტური პინის გაწვდოს მიერ
  for (int pin = 0; pin < 7; pin++) {
    pinMode(Arduino_Pins[pin], OUTPUT);
  }
  pinMode(D1, OUTPUT);
  pinMode(D2, OUTPUT);
}

void loop() {
  // აჩვენოს მიმდინარე რიცხვი 7-სეგმენტურ დისპლეებზე
  displayNumber(k, i);
  
  delay(500); // 0.5 წამი გამოტოვება ზრდის ინტერვალი
  
  i++; // ერთეულების ციფრის გაზრდა
  if (i == 10) { // როდესაც ერთეულების ციფრი 10-ს აღწევს, ააწყოს ისევ 0 და გაზარდოს ათეულების ციფრი
    i = 0;
    k++;
    if (k == 10) { // როდესაც ათეულების ციფრი 10-ს აღწევს, ააწყოს ისევ 0
      k = 0;
    }
  }
}

void displayNumber(int tens, int ones) {
  // ათეულების ციფრის ჩვენება
  for (int j = 0; j < 7; j++) {
    digitalWrite(Arduino_Pins[j], Segment_Pins[tens][j]);
  }
  digitalWrite(D1, LOW); // პირველი ციფრის აქტივაცია
  digitalWrite(D2, HIGH); // მეორე ციფრის უკუქცევა
  delay(5); // მოკლე გამოტოვება სეგმენტის სტაბილურობისთვის
  
  // ერთეულების ციფრის ჩვენება
  for (int j = 0; j < 7; j++) {
    digitalWrite(Arduino_Pins[j], Segment_Pins[ones][j]);
  }
  digitalWrite(D1, HIGH); // პირველი ციფრის უკუქცევა
  digitalWrite(D2, LOW); // მეორე ციფრის აქტივაცია
  delay(5); // მოკლე გამოტოვება სეგმენტის სტაბილურობისთვის
}
